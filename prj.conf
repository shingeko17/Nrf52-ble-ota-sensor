## CMakeLists.txt
```
# SPDX-License-Identifier: MIT
# nRF52840 BLE OTA Sensor - CMake build configuration

cmake_minimum_required(VERSION 3.20.0)
find_package(Zephyr REQUIRED HINTS $ENV{ZEPHYR_BASE})

project(nrf52-ble-ota-sensor
    VERSION 1.0.0
    LANGUAGES C
)

# Include paths
target_include_directories(app PRIVATE
    ${CMAKE_CURRENT_SOURCE_DIR}/include
    ${CMAKE_CURRENT_SOURCE_DIR}/src
)

# Application sources
target_sources(app PRIVATE
    src/main.c
    src/ble_service.c
    src/temp_sensor.c
    src/button_handler.c
    src/led_status.c
    src/power_mgmt.c
)
```

## Kconfig
```
# nRF52840 BLE OTA Sensor - Application Kconfig

mainmenu "nRF52 BLE OTA Sensor Configuration"

source "Kconfig.zephyr"
```

## prj.conf
```kconfig
# ========================================
# nRF52840 BLE OTA Sensor - Kconfig
# ========================================

# --- General ---
CONFIG_HEAP_MEM_POOL_SIZE=4096
CONFIG_MAIN_STACK_SIZE=2048
CONFIG_SYSTEM_WORKQUEUE_STACK_SIZE=2048

# --- Logging ---
CONFIG_LOG=y
CONFIG_LOG_MODE_DEFERRED=y
CONFIG_LOG_BACKEND_UART=y
CONFIG_LOG_DEFAULT_LEVEL=3

# --- GPIO ---
CONFIG_GPIO=y

# --- Sensor (onboard temp) ---
CONFIG_SENSOR=y
CONFIG_TEMP_NRF5=y

# --- Bluetooth ---
CONFIG_BT=y
CONFIG_BT_PERIPHERAL=y
CONFIG_BT_DEVICE_NAME="nRF52_OTA_Sensor"
CONFIG_BT_DEVICE_APPEARANCE=768
CONFIG_BT_MAX_CONN=1
CONFIG_BT_MAX_PAIRED=1

# BLE Security (optional, can enable later)
# CONFIG_BT_SMP=y
# CONFIG_BT_KEYS_OVERWRITE_OLDEST=y

# --- MCUboot (Secure Bootloader) ---
CONFIG_BOOTLOADER_MCUBOOT=y

# --- SMP / mcumgr (OTA Update) ---
CONFIG_NET_BUF=y
CONFIG_ZCBOR=y
CONFIG_MCUMGR=y
CONFIG_MCUMGR_GRP_IMG=y
CONFIG_MCUMGR_GRP_OS=y
CONFIG_MCUMGR_TRANSPORT_BT=y
CONFIG_MCUMGR_TRANSPORT_BT_AUTHEN=n

# Flash backend for mcumgr image upload
CONFIG_FLASH=y
CONFIG_FLASH_MAP=y
CONFIG_FLASH_PAGE_LAYOUT=y
CONFIG_IMG_MANAGER=y
CONFIG_STREAM_FLASH=y

# --- Assert (debug builds) ---
CONFIG_ASSERT=y
CONFIG_ASSERT_LEVEL=2
```

## app.overlay
```dts
/*
 * nRF52840 DK - Device Tree Overlay
 * No external peripherals needed for this project.
 * Using only onboard: temp sensor, LEDs, buttons.
 *
 * The default nrf52840dk_nrf52840.dts already defines:
 * - 4 LEDs (led0..led3)
 * - 4 Buttons (sw0..sw3)
 * - UART0 for logging
 * - Internal TEMP sensor
 *
 * Add overlay entries here if external I2C/SPI
 * sensors are added later.
 */

/ {
	chosen {
		zephyr,console = &uart0;
		zephyr,shell-uart = &uart0;
	};
};
```

## src/main.c
```c
/**
 * @file main.c
 * @brief Application entry point - nRF52840 BLE Sensor with OTA
 * @author Buzz - HCMUT
 */

#include <zephyr/kernel.h>
#include <zephyr/logging/log.h>

#include "app_config.h"
#include "ble_service.h"
#include "temp_sensor.h"
#include "button_handler.h"
#include "led_status.h"
#include "power_mgmt.h"

LOG_MODULE_REGISTER(main, LOG_LEVEL_INF);

int main(void)
{
	int ret;

	LOG_INF("nRF52 BLE OTA Sensor v%s starting...", APP_VERSION_STRING);

	/* Initialize subsystems */
	ret = led_status_init();
	if (ret) {
		LOG_ERR("LED init failed: %d", ret);
		return ret;
	}

	ret = button_handler_init();
	if (ret) {
		LOG_ERR("Button init failed: %d", ret);
		return ret;
	}

	ret = temp_sensor_init();
	if (ret) {
		LOG_ERR("Temp sensor init failed: %d", ret);
		return ret;
	}

	ret = ble_service_init();
	if (ret) {
		LOG_ERR("BLE init failed: %d", ret);
		return ret;
	}

	ret = power_mgmt_init();
	if (ret) {
		LOG_ERR("Power mgmt init failed: %d", ret);
		return ret;
	}

	/* Start BLE advertising */
	ret = ble_service_start_adv();
	if (ret) {
		LOG_ERR("BLE advertising failed: %d", ret);
		return ret;
	}

	LOG_INF("All systems initialized. Advertising as \"%s\"",
		BLE_DEVICE_NAME);

	/* Main loop: read temperature + update BLE */
	while (1) {
		int16_t temp = temp_sensor_read();

		if (ble_service_is_connected()) {
			ble_service_notify_temp(temp);
		}

		k_msleep(TEMP_SAMPLE_INTERVAL_MS);
	}

	return 0;
}
```

## include/app_config.h
```c
/**
 * @file app_config.h
 * @brief Application configuration defines
 * @author Buzz - HCMUT
 */

#ifndef APP_CONFIG_H
#define APP_CONFIG_H

/* Application version */
#define APP_VERSION_MAJOR 1
#define APP_VERSION_MINOR 0
#define APP_VERSION_PATCH 0
#define APP_VERSION_STRING "1.0.0"

/* BLE Configuration */
#define BLE_DEVICE_NAME "nRF52_OTA_Sensor"
#define BLE_ADV_INTERVAL_MIN 160  /* 100ms (160 * 0.625ms) */
#define BLE_ADV_INTERVAL_MAX 320  /* 200ms (320 * 0.625ms) */

/* Custom Service UUIDs */
#define CUSTOM_SERVICE_UUID_VAL \
    BT_UUID_128_ENCODE(0x12345678, 0x1234, 0x5678, 0x1234, 0x56789abcdef0)
#define TEMP_CHAR_UUID_VAL \
    BT_UUID_128_ENCODE(0x12345678, 0x1234, 0x5678, 0x1234, 0x56789abcdef1)
#define BUTTON_CHAR_UUID_VAL \
    BT_UUID_128_ENCODE(0x12345678, 0x1234, 0x5678, 0x1234, 0x56789abcdef2)

/* Temperature sensor */
#define TEMP_SAMPLE_INTERVAL_MS 2000  /* Read every 2 seconds */
#define TEMP_SCALE_FACTOR       100   /* °C × 100 for int16 */

/* LED Configuration */
#define LED_ADV_BLINK_MS     1000  /* Slow blink: advertising */
#define LED_OTA_BLINK_MS     200   /* Fast blink: OTA in progress */

/* Power Management */
#define IDLE_TIMEOUT_MS      30000  /* Enter low power after 30s idle */

#endif /* APP_CONFIG_H */
```

## src/ble_service.c
```c
/**
 * @file ble_service.c
 * @brief BLE GATT service implementation
 * @author Buzz - HCMUT
 */

#include <zephyr/kernel.h>
#include <zephyr/bluetooth/bluetooth.h>
#include <zephyr/bluetooth/hci.h>
#include <zephyr/bluetooth/conn.h>
#include <zephyr/bluetooth/uuid.h>
#include <zephyr/bluetooth/gatt.h>
#include <zephyr/logging/log.h>

#include "app_config.h"
#include "ble_service.h"
#include "led_status.h"

LOG_MODULE_REGISTER(ble_service, LOG_LEVEL_INF);

/* Custom Service UUID */
static struct bt_uuid_128 custom_svc_uuid = BT_UUID_INIT_128(CUSTOM_SERVICE_UUID_VAL);
static struct bt_uuid_128 temp_char_uuid = BT_UUID_INIT_128(TEMP_CHAR_UUID_VAL);
static struct bt_uuid_128 button_char_uuid = BT_UUID_INIT_128(BUTTON_CHAR_UUID_VAL);

/* State */
static struct bt_conn *current_conn;
static bool temp_notify_enabled;
static bool button_notify_enabled;
static int16_t current_temp;
static uint8_t button_state[2]; /* [button_id, pressed] */

/* CCC changed callbacks */
static void temp_ccc_cfg_changed(const struct bt_gatt_attr *attr, uint16_t value)
{
	temp_notify_enabled = (value == BT_GATT_CCC_NOTIFY);
	LOG_INF("Temperature notifications %s",
		temp_notify_enabled ? "enabled" : "disabled");
}

static void button_ccc_cfg_changed(const struct bt_gatt_attr *attr, uint16_t value)
{
	button_notify_enabled = (value == BT_GATT_CCC_NOTIFY);
	LOG_INF("Button notifications %s",
		button_notify_enabled ? "enabled" : "disabled");
}

/* Read callback for temperature */
static ssize_t read_temp(struct bt_conn *conn, const struct bt_gatt_attr *attr,
			 void *buf, uint16_t len, uint16_t offset)
{
	return bt_gatt_attr_read(conn, attr, buf, len, offset,
				 &current_temp, sizeof(current_temp));
}

/* GATT Service Definition */
BT_GATT_SERVICE_DEFINE(custom_svc,
	BT_GATT_PRIMARY_SERVICE(&custom_svc_uuid),

	/* Temperature Characteristic: Read + Notify */
	BT_GATT_CHARACTERISTIC(&temp_char_uuid.uuid,
			       BT_GATT_CHRC_READ | BT_GATT_CHRC_NOTIFY,
			       BT_GATT_PERM_READ,
			       read_temp, NULL, &current_temp),
	BT_GATT_CCC(temp_ccc_cfg_changed,
		     BT_GATT_PERM_READ | BT_GATT_PERM_WRITE),

	/* Button Characteristic: Notify only */
	BT_GATT_CHARACTERISTIC(&button_char_uuid.uuid,
			       BT_GATT_CHRC_NOTIFY,
			       BT_GATT_PERM_NONE,
			       NULL, NULL, &button_state),
	BT_GATT_CCC(button_ccc_cfg_changed,
		     BT_GATT_PERM_READ | BT_GATT_PERM_WRITE),
);

/* Advertising data */
static const struct bt_data ad[] = {
	BT_DATA_BYTES(BT_DATA_FLAGS, (BT_LE_AD_GENERAL | BT_LE_AD_NO_BREDR)),
	BT_DATA(BT_DATA_NAME_COMPLETE, BLE_DEVICE_NAME, sizeof(BLE_DEVICE_NAME) - 1),
};

static const struct bt_data sd[] = {
	BT_DATA_BYTES(BT_DATA_UUID128_ALL, CUSTOM_SERVICE_UUID_VAL),
};

/* Connection callbacks */
static void connected(struct bt_conn *conn, uint8_t err)
{
	if (err) {
		LOG_ERR("Connection failed: %d", err);
		return;
	}

	LOG_INF("Connected");
	current_conn = bt_conn_ref(conn);
	led_status_set(LED_STATE_CONNECTED);
}

static void disconnected(struct bt_conn *conn, uint8_t reason)
{
	LOG_INF("Disconnected (reason: %d)", reason);

	if (current_conn) {
		bt_conn_unref(current_conn);
		current_conn = NULL;
	}

	temp_notify_enabled = false;
	button_notify_enabled = false;
	led_status_set(LED_STATE_ADVERTISING);

	/* Restart advertising */
	ble_service_start_adv();
}

BT_CONN_CB_DEFINE(conn_callbacks) = {
	.connected = connected,
	.disconnected = disconnected,
};

/* Public API */
int ble_service_init(void)
{
	int ret;

	ret = bt_enable(NULL);
	if (ret) {
		LOG_ERR("Bluetooth init failed: %d", ret);
		return ret;
	}

	LOG_INF("Bluetooth initialized");
	return 0;
}

int ble_service_start_adv(void)
{
	int ret;

	ret = bt_le_adv_start(BT_LE_ADV_CONN, ad, ARRAY_SIZE(ad),
			      sd, ARRAY_SIZE(sd));
	if (ret) {
		LOG_ERR("Advertising failed to start: %d", ret);
		return ret;
	}

	LOG_INF("Advertising started");
	led_status_set(LED_STATE_ADVERTISING);
	return 0;
}

bool ble_service_is_connected(void)
{
	return (current_conn != NULL);
}

int ble_service_notify_temp(int16_t temp_value)
{
	if (!current_conn || !temp_notify_enabled) {
		return -ENOTCONN;
	}

	current_temp = temp_value;

	return bt_gatt_notify(current_conn, &custom_svc.attrs[1],
			      &current_temp, sizeof(current_temp));
}

int ble_service_notify_button(uint8_t button_id, bool pressed)
{
	if (!current_conn || !button_notify_enabled) {
		return -ENOTCONN;
	}

	button_state[0] = button_id;
	button_state[1] = pressed ? 1 : 0;

	return bt_gatt_notify(current_conn, &custom_svc.attrs[4],
			      &button_state, sizeof(button_state));
}
```

## src/ble_service.h
```c
/**
 * @file ble_service.h
 * @brief BLE GATT service for sensor data
 * @author Buzz - HCMUT
 */

#ifndef BLE_SERVICE_H
#define BLE_SERVICE_H

#include <stdint.h>
#include <stdbool.h>

/**
 * @brief Initialize BLE subsystem and register GATT services
 * @return 0 on success, negative errno on failure
 */
int ble_service_init(void);

/**
 * @brief Start BLE advertising
 * @return 0 on success, negative errno on failure
 */
int ble_service_start_adv(void);

/**
 * @brief Check if a BLE central is connected
 * @return true if connected
 */
bool ble_service_is_connected(void);

/**
 * @brief Send temperature notification to connected central
 * @param temp_value Temperature in °C × 100
 * @return 0 on success, negative errno on failure
 */
int ble_service_notify_temp(int16_t temp_value);

/**
 * @brief Send button event notification
 * @param button_id Button number (0-3)
 * @param pressed true if pressed, false if released
 * @return 0 on success, negative errno on failure
 */
int ble_service_notify_button(uint8_t button_id, bool pressed);

#endif /* BLE_SERVICE_H */
```

## src/button_handler.c
```c
/**
 * @file button_handler.c
 * @brief Button press/release detection with BLE notification
 * @author Buzz - HCMUT
 */

#include <zephyr/kernel.h>
#include <zephyr/drivers/gpio.h>
#include <zephyr/logging/log.h>

#include "button_handler.h"
#include "ble_service.h"

LOG_MODULE_REGISTER(button_handler, LOG_LEVEL_INF);

/* DK has 4 buttons */
#define NUM_BUTTONS 4

static const struct gpio_dt_spec buttons[NUM_BUTTONS] = {
	GPIO_DT_SPEC_GET(DT_ALIAS(sw0), gpios),
	GPIO_DT_SPEC_GET(DT_ALIAS(sw1), gpios),
	GPIO_DT_SPEC_GET(DT_ALIAS(sw2), gpios),
	GPIO_DT_SPEC_GET(DT_ALIAS(sw3), gpios),
};

static struct gpio_callback button_cb_data[NUM_BUTTONS];

/* Work item to handle button in system workqueue (not ISR context) */
struct button_work {
	struct k_work work;
	uint8_t button_id;
	bool pressed;
};

static struct button_work btn_work[NUM_BUTTONS];

static void button_work_handler(struct k_work *work)
{
	struct button_work *bw = CONTAINER_OF(work, struct button_work, work);

	LOG_INF("Button %d %s", bw->button_id,
		bw->pressed ? "pressed" : "released");

	ble_service_notify_button(bw->button_id, bw->pressed);
}

static void button_isr(const struct device *dev, struct gpio_callback *cb,
		       uint32_t pins)
{
	for (int i = 0; i < NUM_BUTTONS; i++) {
		if (pins & BIT(buttons[i].pin)) {
			int val = gpio_pin_get_dt(&buttons[i]);
			btn_work[i].pressed = (val > 0);
			k_work_submit(&btn_work[i].work);
			break;
		}
	}
}

int button_handler_init(void)
{
	int ret;

	for (int i = 0; i < NUM_BUTTONS; i++) {
		if (!gpio_is_ready_dt(&buttons[i])) {
			LOG_ERR("Button %d GPIO not ready", i);
			return -ENODEV;
		}

		ret = gpio_pin_configure_dt(&buttons[i], GPIO_INPUT);
		if (ret) {
			LOG_ERR("Button %d config failed: %d", i, ret);
			return ret;
		}

		ret = gpio_pin_interrupt_configure_dt(&buttons[i],
						      GPIO_INT_EDGE_BOTH);
		if (ret) {
			LOG_ERR("Button %d interrupt config failed: %d", i, ret);
			return ret;
		}

		gpio_init_callback(&button_cb_data[i], button_isr,
				   BIT(buttons[i].pin));
		gpio_add_callback(buttons[i].port, &button_cb_data[i]);

		/* Init work item */
		btn_work[i].button_id = i;
		k_work_init(&btn_work[i].work, button_work_handler);
	}

	LOG_INF("Button handler initialized (%d buttons)", NUM_BUTTONS);
	return 0;
}
```

## src/button_handler.h
```c
/**
 * @file button_handler.h
 * @brief Button events handler
 * @author Buzz - HCMUT
 */

#ifndef BUTTON_HANDLER_H
#define BUTTON_HANDLER_H

#include <stdint.h>
#include <stdbool.h>

/**
 * @brief Initialize button GPIOs with interrupt callbacks
 * @return 0 on success, negative errno on failure
 */
int button_handler_init(void);

#endif /* BUTTON_HANDLER_H */
```

## src/led_status.c
```c
/**
 * @file led_status.c
 * @brief LED status indicator implementation
 * @author Buzz - HCMUT
 */

#include <zephyr/kernel.h>
#include <zephyr/drivers/gpio.h>
#include <zephyr/logging/log.h>

#include "app_config.h"
#include "led_status.h"

LOG_MODULE_REGISTER(led_status, LOG_LEVEL_INF);

/* nRF52840 DK has 4 LEDs */
#define NUM_LEDS 4

static const struct gpio_dt_spec leds[NUM_LEDS] = {
	GPIO_DT_SPEC_GET(DT_ALIAS(led0), gpios),
	GPIO_DT_SPEC_GET(DT_ALIAS(led1), gpios),
	GPIO_DT_SPEC_GET(DT_ALIAS(led2), gpios),
	GPIO_DT_SPEC_GET(DT_ALIAS(led3), gpios),
};

static led_state_t current_state;
static struct k_timer blink_timer;

static void all_leds_off(void)
{
	for (int i = 0; i < NUM_LEDS; i++) {
		gpio_pin_set_dt(&leds[i], 0);
	}
}

static void blink_handler(struct k_timer *timer)
{
	static bool toggle;

	toggle = !toggle;

	switch (current_state) {
	case LED_STATE_ADVERTISING:
		gpio_pin_set_dt(&leds[0], toggle);  /* LED1 blink */
		break;
	case LED_STATE_OTA:
		gpio_pin_set_dt(&leds[2], toggle);  /* LED3 blink */
		break;
	default:
		break;
	}
}

int led_status_init(void)
{
	int ret;

	for (int i = 0; i < NUM_LEDS; i++) {
		if (!gpio_is_ready_dt(&leds[i])) {
			LOG_ERR("LED %d GPIO not ready", i);
			return -ENODEV;
		}

		ret = gpio_pin_configure_dt(&leds[i], GPIO_OUTPUT_INACTIVE);
		if (ret) {
			LOG_ERR("LED %d config failed: %d", i, ret);
			return ret;
		}
	}

	k_timer_init(&blink_timer, blink_handler, NULL);

	LOG_INF("LED status initialized (%d LEDs)", NUM_LEDS);
	return 0;
}

void led_status_set(led_state_t state)
{
	k_timer_stop(&blink_timer);
	all_leds_off();

	current_state = state;

	switch (state) {
	case LED_STATE_IDLE:
		break;
	case LED_STATE_ADVERTISING:
		k_timer_start(&blink_timer,
			      K_MSEC(LED_ADV_BLINK_MS),
			      K_MSEC(LED_ADV_BLINK_MS));
		break;
	case LED_STATE_CONNECTED:
		gpio_pin_set_dt(&leds[1], 1);  /* LED2 solid */
		break;
	case LED_STATE_OTA:
		k_timer_start(&blink_timer,
			      K_MSEC(LED_OTA_BLINK_MS),
			      K_MSEC(LED_OTA_BLINK_MS));
		break;
	case LED_STATE_ERROR:
		gpio_pin_set_dt(&leds[3], 1);  /* LED4 solid */
		break;
	}

	LOG_DBG("LED state: %d", state);
}
```

## src/led_status.h
```c
/**
 * @file led_status.h
 * @brief LED status indicators
 * @author Buzz - HCMUT
 */

#ifndef LED_STATUS_H
#define LED_STATUS_H

/** LED state machine */
typedef enum {
	LED_STATE_IDLE,         /**< All LEDs off */
	LED_STATE_ADVERTISING,  /**< LED1 slow blink */
	LED_STATE_CONNECTED,    /**< LED2 solid */
	LED_STATE_OTA,          /**< LED3 fast blink */
	LED_STATE_ERROR,        /**< LED4 solid */
} led_state_t;

/**
 * @brief Initialize LED GPIOs
 * @return 0 on success, negative errno on failure
 */
int led_status_init(void);

/**
 * @brief Set LED state
 * @param state New LED state
 */
void led_status_set(led_state_t state);

#endif /* LED_STATUS_H */
```

## src/power_mgmt.c
```c
/**
 * @file power_mgmt.c
 * @brief Zephyr power management - automatic idle sleep
 * @author Buzz - HCMUT
 */

#include <zephyr/kernel.h>
#include <zephyr/pm/pm.h>
#include <zephyr/pm/policy.h>
#include <zephyr/logging/log.h>

#include "power_mgmt.h"

LOG_MODULE_REGISTER(power_mgmt, LOG_LEVEL_INF);

int power_mgmt_init(void)
{
	/*
	 * Zephyr handles idle power management automatically when
	 * CONFIG_PM=y is set. The kernel enters low-power states
	 * (System ON sleep / System OFF) when all threads are idle.
	 *
	 * nRF52840 supports:
	 * - System ON (WFI): ~1.5uA base + wake on any interrupt
	 * - System OFF: ~0.3uA, wake on GPIO/NFC/LPCOMP
	 *
	 * We use System ON sleep since BLE needs periodic wakeup.
	 */

	LOG_INF("Power management initialized (automatic idle sleep)");
	return 0;
}
```

## src/power_mgmt.h
```c
/**
 * @file power_mgmt.h
 * @brief Power management interface
 * @author Buzz - HCMUT
 */

#ifndef POWER_MGMT_H
#define POWER_MGMT_H

/**
 * @brief Initialize power management
 * @return 0 on success, negative errno on failure
 */
int power_mgmt_init(void);

#endif /* POWER_MGMT_H */
```

## src/temp_sensor.c
```c
/**
 * @file temp_sensor.c
 * @brief nRF52840 onboard temperature sensor (TEMP peripheral)
 * @author Buzz - HCMUT
 */

#include <zephyr/kernel.h>
#include <zephyr/drivers/sensor.h>
#include <zephyr/logging/log.h>

#include "app_config.h"
#include "temp_sensor.h"

LOG_MODULE_REGISTER(temp_sensor, LOG_LEVEL_INF);

static const struct device *temp_dev;

int temp_sensor_init(void)
{
	temp_dev = DEVICE_DT_GET(DT_NODELABEL(temp));

	if (!device_is_ready(temp_dev)) {
		LOG_ERR("Temperature sensor not ready");
		return -ENODEV;
	}

	LOG_INF("Temperature sensor initialized");
	return 0;
}

int16_t temp_sensor_read(void)
{
	struct sensor_value val;
	int ret;

	if (!temp_dev) {
		return 0;
	}

	ret = sensor_sample_fetch(temp_dev);
	if (ret) {
		LOG_ERR("Sensor fetch failed: %d", ret);
		return 0;
	}

	ret = sensor_channel_get(temp_dev, SENSOR_CHAN_DIE_TEMP, &val);
	if (ret) {
		LOG_ERR("Sensor get failed: %d", ret);
		return 0;
	}

	/* Convert to int16 (°C × 100) */
	int16_t temp = (int16_t)(val.val1 * TEMP_SCALE_FACTOR +
				  val.val2 / (1000000 / TEMP_SCALE_FACTOR));

	LOG_DBG("Temperature: %d.%02d C", temp / 100, temp % 100);
	return temp;
}
```

## src/temp_sensor.h
```c
/**
 * @file temp_sensor.h
 * @brief Onboard temperature sensor interface
 * @author Buzz - HCMUT
 */

#ifndef TEMP_SENSOR_H
#define TEMP_SENSOR_H

#include <stdint.h>

/**
 * @brief Initialize the temperature sensor
 * @return 0 on success, negative errno on failure
 */
int temp_sensor_init(void);

/**
 * @brief Read current temperature
 * @return Temperature in °C × 100 (e.g., 2350 = 23.50°C)
 */
int16_t temp_sensor_read(void);

#endif /* TEMP_SENSOR_H */
```
